## boards/shields/t_rexth/Kconfig.shield
```kconfig
config SHIELD_T_REXTH_LEFT
  def_bool $(shields_list_contains,t_rexth_left)

config SHIELD_T_REXTH_RIGHT
  def_bool $(shields_list_contains,t_rexth_right)
```

## t_rexth_30/zmk_config/boards/shields/t_rexth/Kconfig.defconfig
```kconfig
config ZMK_BLE
  default y

config ZMK_USB
  default y

if SHIELD_T_REXTH_LEFT

config ZMK_KEYBOARD_NAME
  default "T Rexth"

config ZMK_SPLIT_ROLE_CENTRAL
  default y

endif

if SHIELD_T_REXTH_LEFT || SHIELD_T_REXTH_RIGHT

config ZMK_SPLIT
  default y

endif
```
